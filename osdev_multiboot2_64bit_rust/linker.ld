/* ============================================================
 * linker.ld — x86_64 kernel
 * ============================================================
 */

ENTRY(_start)
OUTPUT_FORMAT(elf64-x86-64)

BASE_ADDRESS = 0x100000;

SECTIONS
{
    . = BASE_ADDRESS;

    /* --------------------------------------------------------
     * Code
     * --------------------------------------------------------
     */
    .text : ALIGN(4096)
    {
        KEEP(*(.multiboot2))
        *(.text.boot)
        *(.text*)
    }

    /* --------------------------------------------------------
     * Read-only data
     * --------------------------------------------------------
     */
    .rodata : ALIGN(4096)
    {
        *(.rodata*)
    }

    /* --------------------------------------------------------
     * Data
     * --------------------------------------------------------
     */
    .data : ALIGN(4096)
    {
        *(.data*)
    }

    /* --------------------------------------------------------
     * BSS + stack
     * --------------------------------------------------------
     */
    .bss : ALIGN(4096)
    {
        *(COMMON)
        *(.bss*)
        *(.bss.stack)
    }

    /DISCARD/ :
    {
        *(.eh_frame)
        *(.comment)
    }
}
