/* Загрузчик просмотрит этот образ и начнет выполнение с символа, обозначенного как точка входа. */
ENTRY(_start)

/* Укажите, куда будут помещены различные разделы объектных файлов в итоговом образе ядра. */
SECTIONS
{
    /* Раньше повсеместно рекомендовали использовать 1M в качестве стартового смещения, 
    так как он был фактически гарантирован доступен в системах BIOS. Однако UEFI усложнил ситуацию,
     и экспериментальные данные явно указывают на то, что 2M — более безопасное место для загрузки. 
     В 2016 году в спецификацию multiboot2 была введена новая функция, информирующая загрузчиков, 
     что ядро можно загрузить в любом месте в пределах диапазона адресов и сможет переместиться для 
     работы с такого адреса, выбранного загрузчиком, чтобы дать загрузчику свободу при выборе памяти, 
     который подтверждается прошивкой, чтобы обойти эту проблему. Здесь эта функция не используется, 
     поэтому 2M был выбран более безопасным вариантом, чем традиционный 1M. 

     . = 2M;

     GRUB обычно не знает, что ядро ожидает именно этот адрес.
     QEMU/VirtualBox — прощают, просто загружают ядро куда захотят.
     Bochs — строгий, прыгает по адресу, который указал multiboot header → тут начинается мусор → трипл-фолт.
     Вывод: 2MB слишком далеко, нужно либо: оставить 1M (0x00100000), проверенный BIOS-safe вариант,
     либо явно использовать multiboot 2 с load_addr, чтобы GRUB загружал туда, куда надо.

     . = 1M;
    */
    
    . = 0x00100000; /* явно задаём адрес начала .text */

	/* Сначала разместим заголовок multiboot, так как его необходимо разместить в самом начале образа, 
    иначе загрузчик не распознает формат файла. Далее добавим раздел .text. */
    .text ALIGN(4K) : {
        KEEP(*(.multiboot))   /* multiboot header всегда первые 4/12 байт */
        _start = .;           /* ENTRY(_start) = начало кода */
        *(.text*)
    }

    /* Данные доступны только для чтения. */
    .rodata ALIGN(4K) : {
        *(.rodata*)
    }

    /* Данные для чтения и записи (инициализированы) */
    .data ALIGN(4K) : {
        *(.data*)
    }

    /* Чтение и запись данных (неинициализированных) и стека. */
    .bss ALIGN(4K) : {
        *(COMMON)
        *(.bss*)
    }
}
