/* =================================================================
 * ФАЙЛ: linker.ld (СТАНДАРТНЫЙ)
 * ================================================================= */

ENTRY(_start)

SECTIONS
{
    /* Ядро начинается с адреса 0x10000 */
    . = 0x10000;

    .text :
    {
        /* Первая секция: точка входа _start из kernel_entry.asm */
        *(.text.entry) 
        
        /* Основной код */
        *(.text)
    }

    .rodata :
    {
        /* Данные, доступные только для чтения (например, строки из C) */
        *(.rodata)
    }

    .data :
    {
        /* Инициализированные данные */
        *(.data)
    }

    .bss :
    {
        /* Неинициализированные данные (должны быть обнулены) */
        *(.bss)
        . = ALIGN(4);
    }
}